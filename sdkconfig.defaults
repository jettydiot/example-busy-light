## sdkconfig.defaults
```kconfig
CONFIG_JETTYD_FLEET_TOKEN="ft_YOUR_TOKEN_HERE"
CONFIG_JETTYD_MQTT_URI="mqtt://mqtt.jettyd.com:1883"
CONFIG_JETTYD_FIRMWARE_VERSION="1.0.0"
CONFIG_JETTYD_DEVICE_TYPE="busy-light"
CONFIG_JETTYD_WIFI_SSID="YourNetworkName"
CONFIG_JETTYD_WIFI_PASSWORD="YourNetworkPassword"
CONFIG_ESP_MAIN_TASK_STACK_SIZE=8192
CONFIG_ESP_SYSTEM_EVENT_TASK_STACK_SIZE=6144
CONFIG_MQTT_TASK_STACK_SIZE=6144
CONFIG_ESPTOOLPY_FLASHSIZE_4MB=y
CONFIG_PARTITION_TABLE_CUSTOM=y
CONFIG_PARTITION_TABLE_CUSTOM_FILENAME="partitions.csv"
CONFIG_PARTITION_TABLE_OFFSET=0x8000
CONFIG_BOOTLOADER_APP_ROLLBACK_ENABLE=y
CONFIG_FREERTOS_IDLE_TASK_STACKSIZE=1536
```
